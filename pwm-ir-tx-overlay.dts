/dts-v1/; /plugin/;

/ {
	compatible = "allwinner,sun4i-a10";

	fragment@0 {
		target = <&pwm>;
		__overlay__ {
			pinctrl-names = "default";
			pinctrl-0 = <&pwm0_pins_a>, <&pwm1_pins_a>;
			status = "okay";
		};
	};

	fragment@1 {
		target-path = "/";
		__overlay__ {
			pwm-ir-transmitter {
				compatible = "pwm-ir-tx";
				pwms = <&pwm 0 25000 0>;
			};
		};
	};

};
